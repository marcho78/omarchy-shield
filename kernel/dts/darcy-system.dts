// SPDX-License-Identifier: GPL-2.0
/*
 * The installed system: the board as darcy.dts describes it, booting Arch
 * Linux ARM from the eMMC (scripts/13) instead of darcy-init. Its
 * initramfs only carries the firmware the built-in drivers load before the
 * root filesystem is up; with no /init in it, the kernel mounts root=
 * itself and starts systemd.
 */
#include "darcy.dts"

/ {
	chosen {
		/*
		 * darcy.dts's, plus the root filesystem and the Wi-Fi country:
		 * scripts/12 puts config.sh SYSTEM_ROOT and WIFI_COUNTRY in
		 * place of @SYSTEM_ROOT@ and @WIFI_COUNTRY@. Without the root
		 * filesystem after 30 s, the kernel panics, and U-Boot shows
		 * the log after the reset.
		 *
		 * tegra-drm stays out until its HDMI bring-up is done: when
		 * udev loads it, it removes the simple framebuffer the console
		 * is on, then finds no output it can drive ("Cannot find any
		 * crtc or sizes"), and the TV goes dark.
		 *
		 * Unlike darcy.dts, no ignore_loglevel: the boot shows on the
		 * TV, and once systemd is up the rootfs lowers the console
		 * level (sysctl.d/20-quiet-console.conf, scripts/13), so later
		 * kernel messages stay off the login prompt.
		 */
		bootargs = "earlycon=uart8250,mmio32,0x70006000 console=ttyS0,115200n8 console=tty0 fbcon=font:TER16x32 consoleblank=0 clk_ignore_unused pd_ignore_unused regulator_ignore_unused cpuidle.off=1 panic=10 printk.devkmsg=on module_blacklist=tegra_drm cfg80211.ieee80211_regdom=@WIFI_COUNTRY@ root=@SYSTEM_ROOT@ rootwait=30 rw";

		/*
		 * U-Boot boots it again after a reboot, and shows its log only
		 * after a panic or a watchdog reset (p2894.c)
		 */
		darcy,system;
	};
};

/* Dump records only for panics (KMSG_DUMP_PANIC): an oops does not stop a reboot */
&{/reserved-memory/ramoops@b0000000} {
	max-reason = <1>;
};
